## yocto/meta-logistics/conf/layer.conf
```bitbake
BBPATH .= ":${LAYERDIR}"

BBFILES += "${LAYERDIR}/recipes-*/*/*.bb \
            ${LAYERDIR}/recipes-*/*/*.bbappend"

BBFILE_COLLECTIONS += "logistics"
BBFILE_PATTERN_logistics = "^${LAYERDIR}/"
BBFILE_PRIORITY_logistics = "10"

LAYERSERIES_COMPAT_logistics = "scarthgap"
LAYERDEPENDS_logistics = "core raspberrypi"
```
